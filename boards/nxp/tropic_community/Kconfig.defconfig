## boards/nxp/tropic_community/Kconfig.defconfig
```kconfig
# Copyright 2026 CogniPilot Foundation
# SPDX-License-Identifier: Apache-2.0

if BOARD_TROPIC_COMMUNITY

config BUILD_OUTPUT_HEX
	bool
	default y

config DISK_DRIVER_SDMMC
	default y if DISK_DRIVERS

if NETWORKING

config NET_L2_ETHERNET
	default y

endif # NETWORKING

endif # BOARD_TROPIC_COMMUNITY
```

## boards/nxp/tropic_community/board.yml
```yaml
board:
  name: tropic_community
  full_name: NXP-Robotics Tropic Community VMU
  vendor: nxp
  socs:
    - name: mimxrt1062
```

## west.yml
```yaml
# SPDX-License-Identifier: Apache-2.0

manifest:
  self:
    path: cerebri_rdd2
    west-commands: scripts/west-commands.yml

  remotes:
    - name: zephyrproject-rtos
      url-base: https://github.com/zephyrproject-rtos
    - name: cognipilot
      url-base: https://github.com/CogniPilot
    - name: pa-spaceline
      url-base: https://github.com/pa-spaceline

  projects:
    - name: zephyr
      remote: cognipilot
      # branch: rdd2-upstream-main
      # pinned: 2026-08-05
      revision: bf19ff6eb2cff5aac91242af56b514273cdf9a94
      path: zephyr
      west-commands: scripts/west-commands.yml
    - name: cmsis
      remote: zephyrproject-rtos
      revision: 512cc7e895e8491696b61f7ba8066b4a182569b8
      path: modules/hal/cmsis
    - name: cmsis-dsp
      remote: zephyrproject-rtos
      revision: 97512610ec92058f0119450b9e743eeb7e95b5c8
      path: modules/lib/cmsis-dsp
    - name: cmsis_6
      remote: zephyrproject-rtos
      revision: b2dfbe1a20bbd49c2d2c605073799671074bbb30
      path: modules/hal/cmsis_6
    - name: fatfs
      remote: zephyrproject-rtos
      revision: f4ead3bf4a6dab3a07d7b5f5315795c073db568d
      path: modules/fs/fatfs
    - name: hal_nxp
      remote: zephyrproject-rtos
      revision: 53946adb08b54449391c1c0c73cdd094d92a3b6e
      path: modules/hal/nxp
    - name: hal_tdk
      remote: zephyrproject-rtos
      revision: 0f209bd0a4b6511c8c6ffddda75da1fe6988df8f
      path: modules/hal/tdk
    - name: segger
      remote: zephyrproject-rtos
      revision: 50892fdbcf2f570e67baa72b8894a66b16946f72
      path: modules/debug/segger
    - name: zros
      remote: cognipilot
      revision: 20ab07983224ca078f17e2e851b4fe8cb92eb517 # Zephyr main module schema
      path: modules/lib/zros
    - name: csyn
      remote: cognipilot
      revision: c1fdc903b5eb48e9a4362c716f50e658bed15961 # synapse_fbs 0.7.0, vehicle-owned topics
      path: modules/lib/csyn
    - name: cerebri_modules
      remote: cognipilot
      revision: ef73a4f8adeb4385c34af4344c9af27e43e02033
      path: modules/lib/cerebri_lockstep
    - name: modelica_models
      remote: cognipilot
      revision: d319854bcbe5758f8beace3c99c6068796585d3f
      path: models/modelica_models
    - name: cyecca
      remote: pa-spaceline
      revision: 3fc65f3e756d5262914e1b6047a38779b699cb17 # main 11/17/25 + hab.py (only on our fork, not upstream)
      path: modules/lib/cyecca
    - name: zenoh-pico
      url: https://github.com/cognipilot/zenoh-pico.git
      revision: cb9d8391c8e3c394fd288f2299c2b6758523b1c6 # cerebri2 4/27/26
      path: modules/lib/zenoh-pico
    - name: zephyr_boards
      remote: pa-spaceline
      revision: 27f07d634cdac38d5f92ad50055c906cd6e73fc0 # tropic_community board + ist8310/rc0/wdog0 + main devicetree migration (only on our fork, not upstream)
      path: modules/lib/zephyr_boards
```
